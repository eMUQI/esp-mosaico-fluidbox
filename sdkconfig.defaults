## sdkconfig.defaults
```kconfig
CONFIG_IDF_TARGET="esp32s31"
CONFIG_ESPTOOLPY_FLASHMODE_QIO=y
CONFIG_ESPTOOLPY_FLASHFREQ_80M=y
CONFIG_ESPTOOLPY_FLASHSIZE_16MB=y
CONFIG_PARTITION_TABLE_CUSTOM=y
CONFIG_PARTITION_TABLE_CUSTOM_FILENAME="partitions.csv"
CONFIG_SPIRAM=y
CONFIG_SPIRAM_MODE_OCT=y
CONFIG_SPIRAM_SPEED_250M=y
# Keep instruction fetches separate from framebuffer DMA in PSRAM.
# CONFIG_SPIRAM_XIP_FROM_PSRAM is not set
CONFIG_ESP_DEFAULT_CPU_FREQ_MHZ_320=y
CONFIG_COMPILER_OPTIMIZATION_PERF=y
CONFIG_FREERTOS_HZ=1000
CONFIG_ESP_MAIN_TASK_STACK_SIZE=6144
CONFIG_TINYUSB_CDC_ENABLED=y
CONFIG_TINYUSB_CDC_COUNT=2
CONFIG_TINYUSB_CDC_RX_BUFSIZE=1024
CONFIG_TINYUSB_CDC_TX_BUFSIZE=1024
CONFIG_TINYUSB_CDC_EP_BUFSIZE=512

CONFIG_ESP_CONSOLE_UART_DEFAULT=y
CONFIG_ESP_CONSOLE_SECONDARY_NONE=y
CONFIG_ESP_IRIS_ENABLE=y
CONFIG_ESP_IRIS_TRANSPORT_USB=y
# CONFIG_ESP_IRIS_TRANSPORT_TCP is not set
CONFIG_ESP_IRIS_NVS_PARTITION_NAME="sysmeta"
CONFIG_ESP_IRIS_USB_PRODUCT="Mosaico FluidBox"
CONFIG_ESP_IRIS_TASK_STACK_SIZE=3328
CONFIG_ESP_IRIS_USB_TASK_STACK_SIZE=2048
CONFIG_ESP_IRIS_SERVICE_STACK_SIZE=4096
CONFIG_ESP_IRIS_SERVICE_PERSISTENT=y
CONFIG_ESP_IRIS_RPC_RESPONSE_PSRAM=y
CONFIG_ESP_IRIS_MEDIA_BUFFER_PSRAM=y
CONFIG_ESP_IRIS_LOG_RING_BYTES=4096
CONFIG_SPIRAM_ALLOW_BSS_SEG_EXTERNAL_MEMORY=y
CONFIG_ESP_IRIS_LOG_RING_STORAGE_PSRAM=y
# Application health is confirmed after the first displayed frame.
# CONFIG_ESP_MOSAICO_APP_AUTO_ACCEPT is not set
CONFIG_ESP_COREDUMP_ENABLE_TO_FLASH=y
CONFIG_APP_RETRIEVE_LEN_ELF_SHA=64
CONFIG_BOOTLOADER_APP_ROLLBACK_ENABLE=y
CONFIG_FACTORY_RECOVERY_BOOT_GPIO=7
CONFIG_FACTORY_RECOVERY_BOOT_DEBOUNCE_MS=50
```
